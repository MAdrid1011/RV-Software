## linux-system/external/Config.in
```kconfig
menu "Zircon packages"
source "$BR2_EXTERNAL_ZIRCON_PATH/package/zircon-validation/Config.in"
endmenu
```

## linux-system/external/configs/zircon_defconfig
```kconfig
BR2_riscv=y
BR2_riscv_custom=y
BR2_RISCV_ISA_RVM=y
BR2_RISCV_ISA_RVA=y
BR2_RISCV_ISA_RVF=y
# BR2_RISCV_ISA_RVD is not set
# BR2_RISCV_ISA_RVC is not set
BR2_RISCV_32=y
BR2_RISCV_ABI_ILP32F=y
BR2_TOOLCHAIN_BUILDROOT_MUSL=y
BR2_PACKAGE_HOST_LINUX_HEADERS_CUSTOM_6_1=y
BR2_STATIC_LIBS=y
BR2_GLOBAL_PATCH_DIR="$(BR2_EXTERNAL_ZIRCON_PATH)/patches"
BR2_TARGET_OPTIMIZATION="-O2"
BR2_INIT_NONE=y
BR2_ROOTFS_OVERLAY="$(BR2_EXTERNAL_ZIRCON_PATH)/board/zircon/rootfs-overlay"
BR2_PACKAGE_BUSYBOX=y
BR2_PACKAGE_ZIRCON_VALIDATION=y
BR2_TARGET_ROOTFS_CPIO=y
# BR2_TARGET_ROOTFS_CPIO_GZIP is not set
```

## linux-system/external/package/zircon-validation/Config.in
```kconfig
config BR2_PACKAGE_ZIRCON_VALIDATION
	bool "zircon-validation"
	help
	  Deterministic userspace checks for the Zircon RV32IMAF Linux port.
```
